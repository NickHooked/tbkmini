## config/west.yml
```yaml
manifest:
  remotes:
    - name: zmkfirmware
      url-base: https://github.com/petejohanson
    # - name: inorichi
    #   url-base: https://github.com/inorichi 
    - name: urob
      url-base: https://github.com/urob
  projects:
    - name: zmk
      remote: urob
      revision: main
      import: app/west.yml
    # - name: zmk-pmw3610-driver
    #   remote: inorichi
    #   revision: feat/pointers-move-scroll
    - name: zmk-helpers
      remote: urob
      revision: main
  self:
    path: config
```
